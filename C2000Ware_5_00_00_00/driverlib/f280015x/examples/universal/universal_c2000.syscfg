/**
 * @cliArgs --device "F280015x" --package "80PN" --part "F280015x_80PN" --context "system" --product "C2000WARE@4.03.00.00"
 * @versions {"tool":"1.0.0+dev"}
 */

/**
 * Import the modules used in this configuration.
 */
const device_support = scripting.addModule("/driverlib/device_support.js");
const sysctl         = scripting.addModule("/driverlib/sysctl.js");
const CMD            = scripting.addModule("/utilities/cmd_tool/cmd_syscfg/source/CMD");
const CMD1           = CMD.addInstance();

/**
 * Write custom configuration values to the imported modules.
 */
CMD.activateCMD = true;

CMD1.$name                    = "CMD0";


CMD1.sectionMemory_text       = ["RAMLS0","RAMLS1"];


CMD1.sectionMemory_ramfunc    = ["RAMM0"];
CMD1.sectionMemory_cinit      = ["RAMM0"];
CMD1.sectionMemory_stack      = ["RAMM1"];
CMD1.sectionMemory_init_array = ["RAMM0"];


CMD1.sectionMemory_bss        = ["RAMLS0"];
CMD1.sectionMemory_const      = ["RAMLS0"];
CMD1.sectionMemory_data       = ["RAMLS0"];


CMD1.sectionMemory_switch     = ["RAMM0"];


CMD1.sectionMemory_sysmem     = ["RAMLS0"];
